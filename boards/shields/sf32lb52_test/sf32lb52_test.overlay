/*
 * Copyright (c) 2025
 * SPDX-License-Identifier: MIT
 *
 * Test shield for SF32LB52-DevKit-LCD
 * Uses the onboard KEY1 (PA34) and KEY2 (PA11) as direct GPIO keys.
 */

#include <zephyr/dt-bindings/gpio/gpio.h>
#include <dt-bindings/zmk/matrix_transform.h>

/ {
    chosen {
        zmk,kscan = &kscan0;
        zmk,matrix-transform = &default_transform;
    };

    default_transform: keypad_transform_0 {
        compatible = "zmk,matrix-transform";
        columns = <2>;
        rows = <1>;
        map = <
            RC(0,0) RC(0,1)
        >;
    };

    kscan0: kscan_0 {
        compatible = "zmk,kscan-gpio-direct";
        wakeup-source;
        input-gpios
            = <&gpioa_32_44 2 (GPIO_ACTIVE_HIGH | GPIO_PULL_DOWN)>  /* KEY1 = PA34 */
            , <&gpioa_00_31 11 (GPIO_ACTIVE_HIGH | GPIO_PULL_DOWN)> /* KEY2 = PA11 */
            ;
    };
};
